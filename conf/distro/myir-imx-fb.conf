## conf/distro/myir-imx-fb.conf
```bitbake
# i.MX DISTRO for the FrameBuffer graphical backend.

include conf/distro/include/myir-imx-base.inc
include conf/distro/include/myir-imx-preferred-env.inc

DISTRO = "myir-imx-fb"

# Remove conflicting backends.
DISTRO_FEATURES_remove = "x11 wayland directfb "
```

## conf/layer.conf
```bitbake
# We have a conf and classes directory, add to BBPATH
BBPATH .= ":${LAYERDIR}"

# We have recipes-* directories, add to BBFILES
BBFILES += "${LAYERDIR}/recipes-*/*/*.bb \
	${LAYERDIR}/recipes-*/*/*.bbappend"

BBFILE_COLLECTIONS += "myir-imx6ulx"
BBFILE_PATTERN_myir-imx6ulx = "^${LAYERDIR}/"
BBFILE_PRIORITY_myir-imx6ulx = "8"
```

## conf/machine/myd-y6ul14x14.conf
```bitbake
#@TYPE: Machine
#@NAME: MYiR MYD-Y6ULL 14x14 board
#@SOC: i.MX6ULL
#@DESCRIPTION: Machine configuration for MYiR MYS6ULL 14x14 board
#@MAINTAINER: Lauren Post <lauren.post@nxp.com>

include conf/machine/include/mys6ulx-base.inc
include conf/machine/include/tune-cortexa7.inc
include conf/machine/include/mys6ulx-common.inc

MACHINE_FIRMWARE_append = " firmware-brcm43362"

SOC_FAMILY = "mx6ul"

KERNEL_DEVICETREE = "myd-y6ul-gpmi-weim.dtb \
    myd-y6ul-emmc.dtb \
"

UBOOT_CONFIG ??= "sd emmc nand"
UBOOT_CONFIG[sd] = "myd_y6ul_14x14_emmc_config,sd"
UBOOT_CONFIG[emmc] = "myd_y6ul_14x14_emmc_config,emmc"
UBOOT_CONFIG[nand] = "myd_y6ul_14x14_nand_config,nand"
UBOOT_CONFIG[mfgtool] = "mx6ull_14x14_evk_config"
```

## conf/machine/mys6ul14x14.conf
```bitbake
#@TYPE: Machine
#@NAME: MYiR MYS6UL14x14 board
#@SOC: i.MX6UL
#@DESCRIPTION: Machine configuration for MYiR MYS6UL board
#@MAINTAINER: Kevin Chen <kevin.chen@myirtech.com>

include conf/machine/include/mys6ulx-base.inc
include conf/machine/include/tune-cortexa7.inc
include conf/machine/include/mys6ulx-common.inc

SOC_FAMILY = "mx6ul"

KERNEL_DEVICETREE = "mys-imx6ul-14x14-evk-emmc.dtb \
                     mys-imx6ul-14x14-evk-gpmi-weim.dtb \
                     mys-imx6ul-14x14-evk-emmc-myb6ulx.dtb \
                     mys-imx6ul-14x14-evk-gpmi-weim-myb6ulx.dtb \
                     mys-imx6ul-14x14-evk-emmc-lcd070.dtb \
                     mys-imx6ul-14x14-evk-gpmi-weim-lcd070.dtb \
                     mys-imx6ul-14x14-evk-emmc-myb6ulx-lcd070.dtb \
                     mys-imx6ul-14x14-evk-gpmi-weim-myb6ulx-lcd070.dtb \
"

UBOOT_CONFIG ??= "sd nand emmc"
UBOOT_CONFIG[sd] = "mys_imx6ul_14x14_emmc_config,sdcard"
UBOOT_CONFIG[emmc] = "mys_imx6ul_14x14_emmc_config,emmc"
UBOOT_CONFIG[nand] = "mys_imx6ul_14x14_nand_config,nand"
UBOOT_CONFIG[mfgtool] = "mx6ul_14x14_evk_config,mfgtool"

# Install brcm firmware
MACHINE_FIRMWARE_append = " firmware-imx-brcm"
```

## conf/machine/mys6ull14x14.conf
```bitbake
#@TYPE: Machine
#@NAME: MYiR MYS6ULL 14x14 board
#@SOC: i.MX6ULL
#@DESCRIPTION: Machine configuration for MYiR MYS6ULL 14x14 board
#@MAINTAINER: Lauren Post <lauren.post@nxp.com>

include conf/machine/include/mys6ulx-base.inc
include conf/machine/include/tune-cortexa7.inc
include conf/machine/include/mys6ulx-common.inc

MACHINE_FIRMWARE_append = " firmware-imx-brcm"

SOC_FAMILY = "mx6ul:mx6ull"

KERNEL_DEVICETREE = "mys-imx6ull-14x14-evk-gpmi-weim.dtb \
                     mys-imx6ull-14x14-evk-emmc.dtb \
                     mys-imx6ull-14x14-evk-gpmi-weim-myb6ulx.dtb \
                     mys-imx6ull-14x14-evk-emmc-myb6ulx.dtb \
                     mys-imx6ull-14x14-evk-gpmi-weim-lcd070.dtb \
                     mys-imx6ull-14x14-evk-emmc-lcd070.dtb \
                     mys-imx6ull-14x14-evk-gpmi-weim-myb6ulx-lcd070.dtb \
                     mys-imx6ull-14x14-evk-emmc-myb6ulx-lcd070.dtb \
"

UBOOT_CONFIG ??= "sd emmc nand"
UBOOT_CONFIG[sd] = "mys_imx6ull_14x14_emmc_config,sdcard"
UBOOT_CONFIG[emmc] = "mys_imx6ull_14x14_emmc_config,emmc"
UBOOT_CONFIG[nand] = "mys_imx6ull_14x14_nand_config,nand"
UBOOT_CONFIG[mfgtool] = "mx6ull_14x14_evk_config"
```

## wic/myd-y6ull14x14-bootpart.wks
```
# short-description: Create SD card image with a boot partition
# long-description: Creates a partitioned SD card image. Boot files
# are located in the first vfat partition.

# Image Creator .wks
part u-boot --source rawcopy --sourceparams="file=u-boot.imx" --ondisk mmcblk --no-table --align 1

# Boot partition
part /boot --source bootimg-partition --ondisk mmcblk0 --fstype=vfat --label boot --active --align 4096 --size 16 --extra-space 0

# Rootfs partition
part / --source rootfs --ondisk mmcblk0 --fstype=ext4 --label root --align 4096
```
